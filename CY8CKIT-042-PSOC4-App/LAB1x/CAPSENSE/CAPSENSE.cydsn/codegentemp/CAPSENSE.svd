# CY8C4245AXI_483 register map
File version: 0.1
PSoC 4200
Registers are 32-bit, read-write, no defined reset value unless marked. A register's access mark holds for its fields unless they carry their own. Offsets are from the block's base; lines under a group give offsets from that group; [hi:lo] are bit positions; {n}, {i} and the like mark numbered series; 'fields as' and 'values as' point back to an identical list; <NAME> marks a mode.

## Memory map
0x00000000 PWM_1
0x00000000 CapSense_1_IDAC1 — IDAC
0x00000000 CapSense_1_IDAC2 — IDAC

## PWM_1
Base 0x00000000
0x40050108 COUNTER — Current counter value
0x4005010C CC — Compare / capture value
0x40050110 CC_BUF — Compare / capture buffer value
0x40050114 PERIOD — Period value
0x40050118 PERIOD_BUF — Period buffer value

## CapSense_1_IDAC1 — IDAC
Base 0x00000000
Same registers: CapSense_1_IDAC2 0x00000000
0x40080004 CSD_IDAC_POLARITY
0x40080008 CSD_IDAC
0x4008FF00 CSD_TRIM1 — CSD IDAC TRIM1
0x4008FF04 CSD_TRIM2 — CSD IDAC TRIM2
